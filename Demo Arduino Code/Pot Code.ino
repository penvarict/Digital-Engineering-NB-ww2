#include<Keyboard.h>

int potPin = A0; // potentiometer is connected to analog 0 pin
int currentStep = 0; // variable used to store the value coming from the sensor
float percent; // variable used to store the chosen flap percentage value (0-45%)
int sensorValue;//value the analog pin reads (integers 0-1023)
float percentVals[] = {0, 11.25, 22.5, 33.75, 45}; //stored value steps (0-45%)
//for more precise steps, this array could be generated by a for loop. 

void setup() {
  Keyboard.begin();
}

void loop() {
 // put your main code here, to run repeatedly:
  sensorValue = analogRead(A0);
  percent = sensorValue * (45.0 / 1023.0);//get percent value
  if(percent> percentVals[currentStep]){//if number is greater than current step
    if(percent-percentVals[currentStep] > abs(percent-percentVals[currentStep+1])){//comparing which percent step is closer
        currentStep++;//increase current step
        Keyboard.press(KEY_F7);//extend flaps to next step
        delay (500);
      Keyboard.releaseAll();
    }
  }
 else if (percent < percentVals[currentStep]){ //if number is less than current step
    if(abs(percent-percentVals[currentStep]) > abs(percent-percentVals[currentStep-1])){//comparing which percent step is closer
        currentStep--;//decrease current step
        Keyboard.press(KEY_F6);//retract flaps to next step
        delay (500);
        Keyboard.releaseAll();
    }
  }
}


